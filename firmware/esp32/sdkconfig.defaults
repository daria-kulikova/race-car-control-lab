## firmware/esp32/sdkconfig.defaults
```kconfig
CONFIG_COMPILER_OPTIMIZATION_PERF=y
CONFIG_COMPILER_CXX_EXCEPTIONS=y
CONFIG_HTTPD_MAX_REQ_HDR_LEN=1024
CONFIG_ESP_SLEEP_POWER_DOWN_FLASH=y
CONFIG_ESP_IPC_TASK_STACK_SIZE=2048
CONFIG_ESP_WIFI_DYNAMIC_TX_BUFFER_NUM=128
# CONFIG_ESP_WIFI_AMPDU_TX_ENABLED is not set
# CONFIG_ESP_WIFI_AMPDU_RX_ENABLED is not set
# CONFIG_ESP_WIFI_NVS_ENABLED is not set
CONFIG_ESP_WIFI_SLP_IRAM_OPT=y
CONFIG_FREERTOS_HZ=1000
CONFIG_FREERTOS_IDLE_TASK_STACKSIZE=2304
CONFIG_FREERTOS_TIMER_TASK_STACK_DEPTH=3072
CONFIG_LOG_DEFAULT_LEVEL_NONE=y
CONFIG_LWIP_IRAM_OPTIMIZATION=y
CONFIG_LWIP_UDP_RECVMBOX_SIZE=64
CONFIG_LWIP_SNTP_UPDATE_DELAY=15000
```

## firmware/src/hardware/actuators/Kconfig.projbuild
```kconfig
menu "Actuators"

    menu "Debugging"

        config DISABLE_DC_COASTING
            bool "Disable coasting of DC motors"
            default n
            help
                Coasting refers to disconnecting the DC motor when zero torque is applied, letting it coast instead of braking. Can be disabled to debug motor driver issues.

    endmenu

endmenu
```

## firmware/src/main/Kconfig.projbuild
```kconfig
menu "Car Configuration"

    menu "RTOS Configuration"

        config TASK_PRIORITY_UDP
            int "Priority UDP Task"
            default 3
            range 0 4
            help
                Task priority of the UDP task. Larger means higher priority.

        config TASK_PRIORITY_CONTROL_LOOP
            int "Priority Control Loop Task"
            default 3
            range 0 4
            help
                Task priority of the control loop. Larger means higher priority.

        config TASK_PRIORITY_POWER_MONITORING
            int "Priority Power Monitoring Task"
            default 1
            range 0 4
            help
                Task priority of the power monitoring task.

        config TASK_PRIORITY_STATE_MACHINE
            int "Priority State Machine Task"
            default 4
            range 0 4
            help
                Task priority of the state machine task.

        config TASK_STACK_SIZE_UDP
            int "Stack Size UDP Task"
            default 3000
            range 1000 10000
            help
                Stack size of the UDP task in bytes.

        config TASK_STACK_SIZE_CONTROL_LOOP
            int "Stack size Control Loop Task"
            default 4000
            range 1000 10000
            help
                Stack size of the control loop task in bytes.

        config TASK_STACK_SIZE_POWER_MONITORING
            int "Stack size Power Monitoring Task"
            default 2000
            range 1000 10000
            help
                Stack size of the power monitoring task in bytes.

        config TASK_STACK_SIZE_STATE_MACHINE
            int "Stack size State Machine Task"
            default 2000
            range 1000 10000
            help
                Stack size of the state machine task in bytes.

    endmenu

    menu "Wi-Fi Settings"

        config ESP_WIFI_SSID
            string "SSID of the Wi-Fi network"
            default ""
            help
                SSID of the Wireless Access Point the car should connect to.

        config ESP_WIFI_PASSWORD
            string "Password of the Wi-Fi network"
            default ""
            help
                Password of the Wireless Access Point the car should connect to.

        config ESP_MAXIMUM_RETRY
            int "Number of retries before connection fails"
            default 5
            range 1 10
            help
                If the connection to the Wireless Access Point fails, the car will retry a given amount of times.

    endmenu

    menu "UDP Settings"

        config UDP_HOST_IP
            string "IP of the computer running CRS"
            help
                The ESP microcontrollers will send their measurements to this address.

        config UDP_HOST_PORT
            int "Port for communication with host"
            default 20211

        config UDP_POLL_FREQUENCY
            int "Polling frequency of the socket"
            default 10000
            help
                Frequency at which the UDP socket is polled and how quickly packets can be sent out. Should be much larger than the tick rate (which is by default 1 kHz).

    endmenu

    menu "Debugging"

        config UDP_DEBUG_PINS
            bool "Enable GPIO output of UDP activity"
            default n
            help
                If this is enabled, the UDP client task will set the GPIO 21 high when it is active and low when it's finished.

    endmenu


    menu "Pinout Configuration"

        config STEERING_FB_PIN
            int "GPIO used for measuring the feedback of the steering actuator"
            default 34
            range 32 39
            help
                The steering actuator provides an analog feedback that can be used to find the current steering position. GPIO values limited to ADC1.


        # SPI Bus

        config SENSOR_GYRO_CS_PIN
            int "SPI Bus: CS gyroscope"
            default 21
            range 1 39

        config SENSOR_ACCEL_CS_PIN
            int "SPI bus: CS accelerometer"
            default 5
            range 1 39

        config SENSOR_SPI_CLK_PIN
            int "SPI bus: CLK"
            default 18
            range 1 39

        config SENSOR_SPI_MOSI_PIN
            int "SPI bus: MOSI"
            default 23
            range 1 39

        config SENSOR_SPI_MISO_PIN
            int "SPI bus: MISO"
            default 19
            range 1 39

    endmenu

    menu "Clock Configuration"

        config SPI_BUS_SPEED
            int "SPI bus frequency"
            default 1000000
            range 50000 10000000
            help
                Sets the clock frequency of the SPI bus

    endmenu

    menu "Sensors"

        config ADC_MULTISAMPLING_BATCH
            int "ADC multiscampling batch"
            default 5
            range 1 10
            help
                Number of ADC samples to take and average for one ADC reading.

    endmenu

    menu "Control"

        config CONTROL_LOOP_RATE
            int "Rate of IMU sampling and steering control"
            default 250
            range 30 250
            help
                Rate that the low-level controllers for steering and the IMU sampling run at.

        choice CONTROL_STEER
            bool "Steering controller choice"

        config CONTROL_STEER_BANGBANG
            bool "Bang-bang"
            help
                Track reference steering angle through a bang-bang controller.

        config CONTROL_STEER_PID
            bool "PID"
            help
                Use a PID approach to control the steering angle.

        endchoice

        config STEER_DEFAULT_KP
            int "PID k_p * 1000"
            default 1500
            help
                P gain of PID controller (multiplied by 1000 for fixed-point number)

        config STEER_DEFAULT_TI
            int "PID T_i * 1000"
            default 0
            help
                Ti gain of PID controller (multiplied by 1000 for fixed-point number)

        config STEER_DEFAULT_TD
            int "PID T_D * 1000"
            default 0
            help
                Td gain of PID controller (multiplied by 1000 for fixed-point number

        config STEER_DEFAULT_N
            int "PID-F N"
            default 1
            help
                N gain of PID-F filtered derivative (!= 0)

        config STEER_DEFAULT_DEADBAND
            int "Deadband of bang-bang controller * 1000 [rad]"
            default 10
            help
                Deadband of bang-bang controller in rad (multiplied by 1000)

        config STEER_DEFAULT_TORQUE
            int "Torque of bang-bang controller (0..100)"
            default 55
            help
                Default torque of bang-bang controller.

        choice CONTROL_DRIVE
            bool "Driving controller choice"

            config CONTROL_DRIVE_UNITY_GAIN
                bool "Unity gain"
                help
                    Simply apply the torque received from CRS.

            config CONTROL_DRIVE_INCREASED_GAIN
                bool "Increased gain"
                help
                    Increase the torque received from CRS by a factor of 3.

        endchoice

        menu "Steering feedback ADC configuration"

            config STEER_ADC_UPPER_LIMIT
                int "Upper voltage limit"
                default 2188
                help
                    The voltage in milli-volt that is measured when the steering wheels point to their left-most position.

            config STEER_ADC_LOWER_LIMIT
                int "Lower voltage limit"
                default 917
                help
                    The voltage in milli-volt that is measured when the steering wheels point to tehir right-most position.

            config STEER_RANGE_DEG
                int "Steering range of car [deg]"
                default 18
                help
                    The amplitude of the steering angle: how much the car can steer to the left or to the right.

        endmenu

        menu "Automatic shutdown"

            config DISCONNECT_THRESHOLD_MS
                int "Disconnect threshold [ms]"
                default 200
                range 4 4000
                help
                    How quickly the car stops if no more control input is received.

        endmenu

    endmenu

endmenu
```
